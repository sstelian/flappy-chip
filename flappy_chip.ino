/*Written by Stelian Saracut
for Arduino Uno and the Nokia 3310 display driven by Adafruit's
PCD8544 library. Developed in Arduino version 1.5.2 */

#include <Adafruit_GFX.h>
#include <Adafruit_PCD8544.h>
#include <EEPROM.h>

Adafruit_PCD8544 display = Adafruit_PCD8544(7, 6, 5, 4, 3);

boolean cs = HIGH,ps = HIGH,alive,b;
int x1,x2,x3,x4,h1,h2,h3,h4,count = 1;
boolean x1os=true,x2os=false,x3os=false,x4os=false; //true if corresponding tube is on screen
byte d, dv,v, k,score;

#define XCHIP 30 //x position of chip (constant)
#define DHINIT 50 //initial horizontal distance between two tubes
#define DVINIT 35
#define DELAY 100

boolean in1 (int l, int r, int left, int right) {
  return ((r>=left)&&(l<= right));
}

boolean in2(int d, int u, int down,int up) {
  return ((u<=up)||(d>= down));
}


int maxim (int n1, int n2, int n3, int n4) {
  int m;
  m = n1;
  if (n2>m) m=n2;
  if (n3>m) m=n3;
  if (n4>m) m=n4;
  return m;
}

static unsigned char PROGMEM tubjos[] = {0xFF,0xF0,
0x80,0x10,
0xDA,0xB0,
0x6D,0x60,
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0x6D,0x60,
};

static unsigned char PROGMEM tubjosplin[] = {0xFF,0xF0,
0xFF,0xF0,
0xFF,0xF0,
0x7F,0xE0,
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0x7F,0xE0,
};

static unsigned char PROGMEM tubsus[] = {0x6D,0x60,
0x5E,0x20,
0x6D,0xA0,
0x5E,0x60,
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0xFF,0xF0,
};

static unsigned char PROGMEM tubsusplin[] = {0x7F,0xE0,
0x7F,0xE0,
0x7F,0xE0,
0x7F,0xE0,
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0xFF,0xF0
};

static unsigned char PROGMEM fundal[] = {
0x00,0x38,0x00,0x00,0x00,0x00,0x3C,0x00,0x00,0x03,0xC0,
0x03,0xC7,0x80,0x03,0xF0,0x01,0xC3,0x80,0x00,0x04,0x30,
0x04,0x28,0x60,0x04,0x48,0x06,0x10,0x40,0xFC,0x08,0x80,
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0x94,0x81,0x4A,0x40,0x81,0x04,0x10,0x00,0x00,0x00,0x00,
};

static unsigned char PROGMEM chip[] = {0x55,0x40,
0xFF,0xE0,
0x80,0x20,
0x80,0x60,
0x80,0x20,
0xFF,0xE0,
0x55,0x40};

static unsigned char PROGMEM chipplin[] = {0xFF,0xE0,
0xFF,0xE0,
0xFF,0xE0,
0xFF,0xE0,
0xFF,0xE0,
0xFF,0xE0,
0xFF,0xE0};

static unsigned char PROGMEM start[] = {
0x00,0x00,0x00,0x00,0x00,0x00,0x00,0x00,0x00,0x00,0x00,
0x63,0x18,0xC6,0x31,0x8C,0x63,0x18,0xC6,0x31,0x8C,0x60,
0x63,0x18,0xC6,0x31,0x8C,0x63,0x18,0xC6,0x31,0x8C,0x60,
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0x00,0x00,0x00,0x00,0x00,0x00,0x00,0x00,0x00,0x00,0x00,
};

void setup() {
  Serial.begin(9600);
  PORTC = 1;
  display.begin();
  display.setContrast(55);
  display.clearDisplay();
  display.drawBitmap(0, 0,start, 84, 48, 1);
  display.setCursor(6,20);
  display.print("FLAPPY CHIP");
  display.display();
  delay(3000);
  display.clearDisplay();

}

void loop() {
  gameLoop();
  finalScore();
}

void gameLoop() {
  b = false;
  k = 0 ;
  v = 20;
  x1 = 84;
  x2 = 0;
  x3 = 0;
  x4 = 0;
  score = 0;
  count = 1;
  x1os = true;
  x2os = false;
  x3os = false;
  x4os = false;
  d = DHINIT;
  dv = DVINIT;
  beginning();
  while (digitalRead(A0) == HIGH) ;
  alive = true;
 while (alive) {
   randomSeed(analogRead(A1));
   k++;
   button();
   dispChip();
   if (x1<-12) {
     x1=0;
     x1os=false; //x1 goes out of display
   }
   if (x2<-12) {
     x2=0;
     x2os=false;
   }
   if (x3<-12) {
     x3=0;
     x3os=false;
   }
   if (x4<-12) {
     x4=0;
     x4os=false;
   }
   if ((x1os == false) && ((84-maxim(x1,x2,x3,x4)) == d)) {
      x1=84;
      h1 = random(5,35);
      x1os = true;
   }
   if ((x2os == false) && ((84-maxim(x1,x2,x3,x4)) == d)) {
      x2=84;
      h2 = random(5,35);
      x2os = true;
   }
    if ((x3os == false) && ((84-maxim(x1,x2,x3,x4)) == d)) {
      x3=84;
      h3 = random(5,35);
      x3os = true;
   }
    if ((x4os == false) && ((84-maxim(x1,x2,x3,x4)) == d)) {
      x4=84;
      h4 = random(5,35);
      x4os = true;
   }

   if (x1os) x1--;
   if (x2os) x2--;
   if (x3os) x3--;
   if (x4os) x4--;
   count++;
   dispTube();
   display.print("           ");
   display.print(score);
   display.display();
   if (count%50 == 0) {
    dv = dv-1;
    d= d-1;
   }
   if (k = 10) b = false;

  if (x1os)
   if (in1(XCHIP,XCHIP+11,x1,x1+12))
    if (in2(v+7,v,h1+dv,h1)) {
     dead(v);
     alive = false;
    }
  if (x2os)
   if (in1(XCHIP,XCHIP+11,x2,x2+12))
    if (in2(v+7,v,h2+dv,h2)) {
     dead(v);
     alive = false;
    }
  if (x3os)
   if (in1(XCHIP,XCHIP+11,x3,x3+12))
    if (in2(v+7,v,h3+dv,h3)) {
     dead(v);
     alive = false;
    }
   if (x4os)
    if (in1(XCHIP,XCHIP+11,x4,x4+12))
      if (in2(v+7,v,h4+dv,h4)) {
     dead(v);
     alive = false;
    }
    if ((v >=250) && (v <=255))
     dead(0);
  if ((x1os && (x1==XCHIP))||(x2os && (x2==XCHIP))||(x3os && (x3==XCHIP))
     || (x4os && (x4==XCHIP))) score++;
   delay(DELAY);
 }
 }

boolean debounce(boolean last) {
 boolean current = digitalRead(A0);
 if (last != current) {
   delay(5);
   current = digitalRead(A0);
 }
 return current;
}

 void button ()  {
  cs = debounce(ps);
   if ((cs != ps) && (cs == LOW))
      b = true;
   if (b == true)
     v -= 4;
     else
     v += 1;
   if (v > 41) alive = false;
   ps = cs;
}

void dispChip () {
 display.clearDisplay();
 display.drawBitmap(0, 33,fundal, 84, 20, 1);
 display.drawBitmap(XCHIP, v,chipplin, 11, 7, 0);
 display.drawBitmap(XCHIP, v,chip, 11, 7, 1);
}

void dispTube () {

 if (x1os) {
 display.drawBitmap(x1, h1+dv,tubjosplin, 12, 32, 0);
 display.drawBitmap(x1, h1+dv,tubjos, 12, 32, 1);
 display.drawBitmap(x1, -32+h1,tubsusplin, 12, 32, 0);
 display.drawBitmap(x1, -32+h1,tubsus, 12, 32, 1);
 }
 if (x2os) {
 display.drawBitmap(x2, h2+dv,tubjosplin, 12, 32, 0);
 display.drawBitmap(x2, h2+dv,tubjos, 12, 32, 1);
 display.drawBitmap(x2, -32+h2,tubsusplin, 12, 32, 0);
 display.drawBitmap(x2, -32+h2,tubsus, 12, 32, 1);
 }
 if (x3os) {
 display.drawBitmap(x3, h3+dv,tubjosplin, 12, 32, 0);
 display.drawBitmap(x3, h3+dv,tubjos, 12, 32, 1);
 display.drawBitmap(x3, -32+h3,tubsusplin, 12, 32, 0);
 display.drawBitmap(x3, -32+h3,tubsus, 12, 32, 1);
 }
 if (x4os) {
 display.drawBitmap(x4, h4+dv,tubjosplin, 12, 32, 0);
 display.drawBitmap(x4, h4+dv,tubjos, 12, 32, 1);
 display.drawBitmap(x4, -32+h4,tubsusplin, 12, 32, 0);
 display.drawBitmap(x4, -32+h4,tubsus, 12, 32, 1);
 }
}

void dead (byte vi) {
 for (v=vi; v<41; v++) {
       dispChip();
       dispTube();
       display.print("           ");
       display.print(score);
       display.display();
       delay(20);
     }
}

void beginning () {
 display.clearDisplay();
 display.drawBitmap(0, 33,fundal, 84, 20, 1);
 display.drawBitmap(30, v,chip, 11, 7, 1);
 display.print("Press to start");
 display.display();
}

byte getHighScore() {
 int i = 0;
 byte hs = 0;
 boolean found = false;
 while ((i<1022) && (!found)) {
   if (EEPROM.read(i) == 'H')
     if (EEPROM.read(i+1) == 'S') {
       hs = EEPROM.read(i+2);
       found = true;
     }
   i++;
 }
 return hs;
}

void setHighScore (byte hs) {
  int i = 0, j=0;
  boolean found = false;
  while ((i<1022) && (!found)) {
    if (EEPROM.read(i) == 'H')
     if (EEPROM.read(i+1) == 'S') {
       EEPROM.write(i,0xFF);
       j = i+2;
       found = true;
     }
   i++;
  }
  EEPROM.write(j,'H');
  EEPROM.write(j+1,'S');
  EEPROM.write(j+2,hs);

}

void finalScore() {
  display.clearDisplay();
  display.drawBitmap(0, 0,start, 84, 48, 1);
  if (score <= getHighScore()) {
     display.setCursor(4,10);
     display.print("Your score:");
     display.print(score);
     display.setCursor(6,30);
     display.print("Highscore:");
     display.print(getHighScore());
     display.display();
  }
  else
  {
    display.setCursor(4,10);
    display.print("New Highscore");
    display.setCursor(37,22);
    display.print(score);
    display.display();
    setHighScore(score);
  }
  while (digitalRead(A0) == HIGH) ;

}
